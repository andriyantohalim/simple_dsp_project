## Kconfig
```kconfig
#
# (C) Copyright 2023
# Andriyanto Halim andriyanto.halim@gmail.com
# Main Menu
#
mainmenu "Project Configuration"

menu "Clock Configuration"
    choice
        prompt "Select Clock Frequency"
        default CLOCK_64_MHz

        config CLOCK_64_MHz
            bool "64 MHz"

        config CLOCK_32_MHz
            bool "32 MHz"

        config CLOCK_16_MHz
            bool "16 MHz"
    endchoice
endmenu # "Clock Configuration"

config ADC_ENABLE
    bool "Enable ADC"
    default n
source "adc/Kconfig"

config PWM_ENABLE
    bool "Enable PWM"
    default n
source "pwm/Kconfig"

config DSP_ENABLE
    bool "Enable DSP"
    default n
source "dsp/Kconfig"
```

## adc/Kconfig
```kconfig
#
# (C) Copyright 2023
# Andriyanto Halim andriyanto.halim@gmail.com
# ADC Menu
#
menu "ADC Configuration"
    depends on ADC_ENABLE

    config ADC_CH0_ENABLE
        bool "Enable ADC Channel 0"
        default n
    
    menu "ADC CH0 Configuration"
        depends on ADC_CH0_ENABLE
        config ADC_CH0_OFFSET
            int "ADC CH0 default offset"
            range 0 2048
            default 1024
    endmenu # "ADC CH0 Configuration"

  
    config ADC_CH1_ENABLE
        bool "Enable ADC Channel 1"
        default n

    config ADC_CH2_ENABLE
        bool "Enable ADC Channel 2"
        default n
    
endmenu # "ADC Configuration"
```

## dsp/Kconfig
```kconfig
#
# (C) Copyright 2023
# Andriyanto Halim andriyanto.halim@gmail.com
# DSP Menu
#
menu "DSP Configuration"
    depends on DSP_ENABLE

    config DSP_PI_CTRL_ENABLE
        bool "Enable PI_Controller"
        default n
    
    menu "PI Controller Configuration"
        depends on DSP_PI_CTRL_ENABLE
        
        config PI_CTRL_KP
            int "Kp Value"
            range 0 65535
            default 0
        
        config PI_CTRL_KI
            int "Ki Value"
            range 0 65535
            default 0
        
        config PI_CTRL_SCALING
            string "Scaling"
            default "0.0f"

    endmenu # "PI Controller Configuration"
    
endmenu # "DSP Configuration"
```

## pwm/Kconfig
```kconfig
#
# (C) Copyright 2023
# Andriyanto Halim andriyanto.halim@gmail.com
# PWM Menu
#
menu "PWM Configuration"
    depends on PWM_ENABLE

    config PWM0_ENABLE
        bool "Enable PWM 0"
        default n
    
    menu "PWM0 Configuration"
        depends on PWM0_ENABLE
        
        config PWM0_PERIOD
            int "PWM0 Period Value"
            range 0 65535
            default 1024
        
        config PWM0_COMPARE
            int "PWM0 Compare Value"
            range 0 65535
            default 1024

    endmenu # "PWM0 Configuration"
    
    config PWM1_ENABLE
        bool "Enable PWM 1"
        default n

    config PWM2_ENABLE
        bool "Enable PWM 2"
        default n

endmenu # "PWM Configuration"
```
